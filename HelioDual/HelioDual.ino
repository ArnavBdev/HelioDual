/*
 * Single-sensor dual-axis solar tracker.
 *
 * Recovers a two-axis pointing error from one photoresistor by
 * synchronous detection. Each axis dithers along a sine path at its own
 * frequency; correlating the light signal against each reference
 * separates the two gradients from the single combined measurement.
 *
 * Hardware
 *   Arduino Uno
 *   2x SG90 servo          roll D9, pitch D10, 5V, GND
 *   KY-018 light module    S -> A0, middle -> 5V, - -> GND
 *
 * The photoresistor must be collimated (2-3 cm opaque tube, ~26 deg
 * acceptance) and mounted on the moving platform along its normal.
 * Uncollimated, the angular gradient is too shallow to resolve.
 *
 * Serial console at 115200 baud; '?' lists commands.
 */

#include <Servo.h>

const uint8_t PIN_ROLL  = 9;
const uint8_t PIN_PITCH = 10;
const uint8_t PIN_LDR   = A0;
const uint8_t PIN_LED   = 13;

/*
 * Sensor conditioning.
 *   USE_INTERNAL_PULLUP  1 for a bare photoresistor tied to GND, which
 *                        uses the AVR pullup as the upper divider leg.
 *                        0 for a module carrying its own resistor.
 *   INVERT_READING       1 when raw ADC falls as light rises.
 *
 * KY-018 board revisions differ in divider orientation. Confirm with
 * the 'm' light meter rather than the datasheet.
 */
#define USE_INTERNAL_PULLUP 0
#define INVERT_READING      1

const float CENTER   = 90.0;
const float LIMIT_LO = 55.0;
const float LIMIT_HI = 125.0;

/*
 * Dither references, as whole cycles per measurement window. Integer
 * cycle counts over a common window are orthogonal, so each axis'
 * reference rejects the other's motion exactly. The counts are coprime
 * so that harmonics generated by backlash distortion on one axis never
 * fall on the other's fundamental.
 */
const uint8_t SAMPLES   = 120;
const uint8_t SAMPLE_MS = 25;     // 3.0 s window
const uint8_t CYC_ROLL  = 2;      // 0.67 Hz
const uint8_t CYC_PITCH = 3;      // 1.00 Hz

float dither      = 5.0;   // deg, acquisition
float ditherLock  = 3.5;   // deg, tracking; must exceed gear backlash
float gainRel     = 8.0;   // deg per unit normalised correlation
float relDead     = 0.03;  // correlation treated as zero below this
float maxMove     = 2.5;   // deg per window, locked
float maxMoveHunt = 5.0;   // deg per window, converging
int   lightFloor  = 150;   // mean below this is outside the cone

Servo servoRoll, servoPitch;
float cmdRoll    = CENTER;   // commanded position, dither included
float cmdPitch   = CENTER;
float baseRoll   = CENTER;   // aim point the dither is centred on
float basePitch  = CENTER;
float slideRoll  = 0.0;      // per-sample drift applied to the base
float slidePitch = 0.0;

bool    tracking  = false;
int     lastLight = 0;
int     bestLight = 0;
uint8_t lockCount = 0;
bool    lost      = false;
uint8_t darkCount = 0;

bool     benchActive = false;
bool     benchCSV    = false;
uint32_t benchSum    = 0;
uint16_t benchN      = 0;

void benchSample(int v) {
  if (!benchActive) return;
  benchSum += (uint32_t)v;
  benchN++;
  if (benchCSV) {
    Serial.print(millis()); Serial.print(F(",tracked,")); Serial.println(v);
  }
}

float clampLimit(float v) {
  if (v < LIMIT_LO) return LIMIT_LO;
  if (v > LIMIT_HI) return LIMIT_HI;
  return v;
}

float clampStep(float v, float lim) {
  if (v >  lim) return  lim;
  if (v < -lim) return -lim;
  return v;
}

/*
 * writeMicroseconds rather than write(): write() quantises to whole
 * degrees, roughly 10 us per step, which is coarser than the dither
 * increments and would render the sine as a staircase.
 */
void writeServos() {
  float r = clampLimit(cmdRoll);
  float p = clampLimit(cmdPitch);
  servoRoll.writeMicroseconds( (int)(544.0 + r * (1856.0 / 180.0)) );
  servoPitch.writeMicroseconds((int)(544.0 + p * (1856.0 / 180.0)) );
}

// Rate-limited move. Step changes excite the platform's resonance and
// corrupt the readings that follow.
void rampRate(float targetRoll, float targetPitch, float step, uint8_t ms) {
  for (int guard = 0; guard < 800; guard++) {
    float dR = targetRoll  - cmdRoll;
    float dP = targetPitch - cmdPitch;
    if (fabs(dR) <= step && fabs(dP) <= step) break;
    cmdRoll  += clampStep(dR, step);
    cmdPitch += clampStep(dP, step);
    writeServos();
    delay(ms);
  }
  cmdRoll  = targetRoll;
  cmdPitch = targetPitch;
  writeServos();
}

void rampTo(float targetRoll, float targetPitch) {
  rampRate(targetRoll, targetPitch, 0.5, 6);
}

void syncBase() {
  baseRoll   = cmdRoll;
  basePitch  = cmdPitch;
  slideRoll  = 0.0;
  slidePitch = 0.0;
}

/*
 * Both readers return brightness: larger is brighter, whichever way the
 * hardware divider is oriented. Changing sensors means changing
 * INVERT_READING and nothing else.
 */

// Single conversion for use inside the correlation loop, where the sum
// over 120 samples provides the averaging. Filtering here would add lag
// and blur the phase.
int readFast() {
#if INVERT_READING
  return 1023 - analogRead(PIN_LDR);
#else
  return analogRead(PIN_LDR);
#endif
}

// Averaged read for stationary measurements.
int readLight() {
  long sum = 0;
  for (uint8_t i = 0; i < 8; i++) {
    sum += analogRead(PIN_LDR);
    delay(2);
  }
  int raw = (int)(sum / 8);
#if INVERT_READING
  return 1023 - raw;
#else
  return raw;
#endif
}

/*
 * One measurement window.
 *
 * Correlating the light signal against each axis' dither reference
 * yields that axis' gradient. The correlation is zero at the peak,
 * where the signal appears at twice the dither frequency and the
 * products cancel over a full cycle.
 *
 * Dither amplitude widens every fourth locked window. An amplitude
 * narrower than the gear backlash moves the command without moving the
 * platform, producing a flat correlation that is indistinguishable from
 * being centred; the periodic wide window separates the two cases.
 */
void trackWindow() {
  bool  verify = (lockCount >= 2) && ((lockCount & 3) == 0);
  float A = (lockCount >= 2 && !verify) ? ditherLock : dither;

  float loB = LIMIT_LO + A;
  float hiB = LIMIT_HI - A;

  float corrR = 0.0, corrP = 0.0, sumL = 0.0;
  float quadR = 0.0, quadP = 0.0;

  for (uint8_t k = 0; k < SAMPLES; k++) {
    float ph = TWO_PI * (float)k / (float)SAMPLES;
    float sr = sin(CYC_ROLL  * ph);
    float sp = sin(CYC_PITCH * ph);
    float cr = cos(CYC_ROLL  * ph);
    float cp = cos(CYC_PITCH * ph);

    baseRoll  += slideRoll;
    basePitch += slidePitch;
    if (baseRoll  < loB) baseRoll  = loB;
    if (baseRoll  > hiB) baseRoll  = hiB;
    if (basePitch < loB) basePitch = loB;
    if (basePitch > hiB) basePitch = hiB;

    cmdRoll  = baseRoll  + A * sr;
    cmdPitch = basePitch + A * sp;
    writeServos();

    delay(SAMPLE_MS);

    float v = (float)readFast();
    sumL  += v;
    corrR += v * sr;
    corrP += v * sp;
    quadR += v * cr;
    quadP += v * cp;
    benchSample((int)v);
  }

  float mean = sumL / (float)SAMPLES;
  lastLight  = (int)mean;
  if (lastLight > bestLight) bestLight = lastLight;

  /*
   * Quadrature detection. Sensor response time and mechanical lag shift
   * the signal out of phase with the command, so the in-phase term
   * alone recovers only cos(phi) of the true amplitude, and the faster
   * axis loses more. The magnitude of I and Q together is independent
   * of that phase; the sign of I still gives direction while the lag
   * stays under a quarter cycle.
   */
  float IR = 2.0 * corrR / (float)SAMPLES;
  float QR = 2.0 * quadR / (float)SAMPLES;
  float IP = 2.0 * corrP / (float)SAMPLES;
  float QP = 2.0 * quadP / (float)SAMPLES;

  float ampR = sqrt(IR * IR + QR * QR);  if (IR < 0) ampR = -ampR;
  float ampP = sqrt(IP * IP + QP * QP);  if (IP < 0) ampP = -ampP;

  // Normalising by the mean makes the result a fractional modulation
  // depth, so a given angular error maps to the same value at any
  // illumination level.
  float relR = (mean > 1.0) ? (ampR / mean) : 0.0;
  float relP = (mean > 1.0) ? (ampP / mean) : 0.0;

  bool haveSignal = (mean >= (float)lightFloor);
  bool haveSlope  = (fabs(relR) > relDead) || (fabs(relP) > relDead);

  float mm = (lockCount >= 2) ? maxMove : maxMoveHunt;

  float mvR = 0.0, mvP = 0.0;
  if (haveSignal && haveSlope) {
    mvR = clampStep(gainRel * relR, mm);
    mvP = clampStep(gainRel * relP, mm);
    lockCount = 0;
    lost = false;
  } else if (haveSignal) {
    if (lockCount < 250) lockCount++;   // flat and illuminated: at peak
    lost = false;
  } else {
    lockCount = 0;                      // flat and dark: no signal
    lost = true;
  }

  // Distribute the correction across the next window so the aim point
  // drifts continuously underneath the dither.
  slideRoll  = mvR / (float)SAMPLES;
  slidePitch = mvP / (float)SAMPLES;

  if (lockCount >= 2) digitalWrite(PIN_LED, HIGH);
  else                digitalWrite(PIN_LED, !digitalRead(PIN_LED));

  Serial.print(F("roll="));   Serial.print(baseRoll, 1);
  Serial.print(F(" pitch=")); Serial.print(basePitch, 1);
  Serial.print(F("  cR="));   Serial.print(relR, 3);
  Serial.print(F(" cP="));    Serial.print(relP, 3);
  Serial.print(F("  light="));Serial.print(lastLight);
  Serial.print(F("  "));
  int bars = lastLight / 32;
  for (int i = 0; i < bars; i++) Serial.print('#');
  if (lost)                Serial.print(F("  [dark]"));
  else if (verify)         Serial.print(F("  [verify]"));
  else if (lockCount >= 2) Serial.print(F("  [locked]"));
  Serial.println();
}

/*
 * Peak-find on one axis by sweeping in both directions and averaging
 * the two results. Sensor lag displaces the apparent peak in the
 * direction of travel, so opposing passes carry equal and opposite
 * bias and their mean is unbiased for any response time. A single pass
 * can only reduce the bias by sweeping slower.
 */
float refineAxis(bool isRoll, float centre, float span) {
  const float   step = 0.8;
  const uint8_t dt   = 30;
  float lo = clampLimit(centre - span);
  float hi = clampLimit(centre + span);

  float peak[2] = { centre, centre };

  for (uint8_t pass = 0; pass < 2; pass++) {
    bool  fwd  = (pass == 0);
    float from = fwd ? lo : hi;
    float to   = fwd ? hi : lo;

    if (isRoll) rampRate(from, cmdPitch, 0.9, 5);
    else        rampRate(cmdRoll, from, 0.9, 5);
    delay(180);

    int   best    = -1;
    float bestPos = centre;
    float x = from;
    while (fwd ? (x <= to) : (x >= to)) {
      if (isRoll) cmdRoll = x; else cmdPitch = x;
      writeServos();
      delay(dt);
      int v = readFast();
      if (v > best) { best = v; bestPos = x; }
      x += fwd ? step : -step;
    }
    peak[pass] = bestPos;
  }

  float mid = (peak[0] + peak[1]) * 0.5;
  Serial.print(isRoll ? F("  refine roll  ") : F("  refine pitch "));
  Serial.print(peak[0], 1); Serial.print(F(" / ")); Serial.print(peak[1], 1);
  Serial.print(F("  -> "));  Serial.println(mid, 1);
  return mid;
}

/*
 * Acquisition. Outside the collimator's acceptance cone the signal is
 * flat and there is no gradient to correlate, so the travel is swept on
 * a serpentine raster and the brightest point taken as a starting
 * estimate. The coarse pass is deliberately fast and lag-biased; the
 * bidirectional refine that follows removes the bias.
 */
void scanAcquire() {
  const int     rows  = 6;
  const float   pStep = (LIMIT_HI - LIMIT_LO) / (float)(rows - 1);
  const float   dR    = 1.2;
  const uint8_t dt    = 22;     // ~55 deg/s

  int   best  = -1;
  float bestR = CENTER, bestP = CENTER;

  Serial.println(F("acquiring"));

  for (int i = 0; i < rows; i++) {
    float p    = LIMIT_LO + i * pStep;
    bool  fwd  = ((i & 1) == 0);
    float from = fwd ? LIMIT_LO : LIMIT_HI;
    float to   = fwd ? LIMIT_HI : LIMIT_LO;

    rampRate(from, p, 0.9, 5);
    delay(120);

    float r = from;
    while (fwd ? (r <= to) : (r >= to)) {
      cmdRoll  = r;
      cmdPitch = p;
      writeServos();
      delay(dt);
      int v = readFast();
      if (v > best) { best = v; bestR = r; bestP = p; }
      r += fwd ? dR : -dR;
    }

    digitalWrite(PIN_LED, !digitalRead(PIN_LED));
    Serial.print('.');
  }
  Serial.println();

  Serial.print(F("coarse best ")); Serial.print(best);
  Serial.print(F(" at roll="));    Serial.print(bestR, 0);
  Serial.print(F(" pitch="));      Serial.println(bestP, 0);

  if (best < lightFloor) {
    rampTo(bestR, bestP);
    syncBase();
    Serial.println(F("no source above light floor; tracking off"));
    tracking = false;
    lost = false;
    return;
  }

  rampTo(bestR, bestP);
  delay(150);
  float rr = refineAxis(true,  bestR, 10.0);
  rampTo(rr, bestP);
  float pp = refineAxis(false, bestP, 10.0);
  rampTo(rr, pp);

  syncBase();
  delay(150);
  lastLight = readLight();
  lockCount = 0;

  Serial.print(F("acquired roll=")); Serial.print(rr, 1);
  Serial.print(F(" pitch="));        Serial.print(pp, 1);
  Serial.print(F(" light="));        Serial.println(lastLight);
  lost = false;
}

const float LASH_STEP = 0.25;

/*
 * Blocks until the photoresistor stops drifting, or until the timeout
 * expires. CdS cells settle over hundreds of milliseconds; a fixed
 * delay either wastes time or samples a reading that is still moving,
 * and a moving reference corrupts every reversal measured against it.
 */
int waitSettled(uint16_t maxMs) {
  int prev = readFast();
  uint32_t t0 = millis();
  while (millis() - t0 < maxMs) {
    delay(80);
    int now = readFast();
    if (abs(now - prev) <= 2) return now;
    prev = now;
  }
  return prev;
}

/*
 * Apparent backlash at one sweep rate. Parks on a flank of the light
 * curve, takes up the lash in one direction, then reverses and counts
 * commanded travel until the reading responds.
 *
 * Detection is directional: reversing moves away from the peak, so only
 * a fall counts. An undirected threshold would also fire on the cell
 * still rising toward its settled value.
 */
float measureBacklash(bool isRoll, uint8_t dt) {
  const float step  = LASH_STEP;
  const float runUp = 6.0;
  const float offs  = 8.0;

  float peak  = isRoll ? baseRoll : basePitch;
  float start = clampLimit(peak - offs);

  if (isRoll) rampTo(start, cmdPitch);
  else        rampTo(cmdRoll, start);
  int first = waitSettled(2500);

  float x = start;
  for (int i = 0; i < (int)(runUp / step); i++) {
    x += step;
    if (isRoll) cmdRoll = x; else cmdPitch = x;
    writeServos();
    delay(dt);
  }
  int lightA = waitSettled(2500);

  float slope = fabs((float)(lightA - first)) / runUp;
  if (slope < 2.0) {
    Serial.println(F("  flank too shallow to measure"));
    return -1.0;
  }
  float thresh = slope * 0.6;   // 0.6 deg of real motion

  float back = 0.0;
  for (int i = 0; i < 160; i++) {
    x -= step;
    if (isRoll) cmdRoll = x; else cmdPitch = x;
    writeServos();
    delay(dt);
    back += step;
    if ((float)(lightA - readFast()) > thresh) break;   // fall only
  }

  Serial.print(isRoll ? F("    roll  ") : F("    pitch "));
  Serial.print(LASH_STEP * 1000.0 / (float)dt, 1);
  Serial.print(F(" deg/s -> ")); Serial.print(back, 2);
  Serial.print(F(" deg  (flank ")); Serial.print(slope, 1);
  Serial.println(F(" counts/deg)"));
  return back;
}

/*
 * Separates mechanical backlash from sensor lag:
 *
 *     apparent = lash + v * tau
 *
 * Lash is rate-independent; sensor lag contributes an angle
 * proportional to sweep rate. Measuring at two rates solves for both,
 * and the zero-rate intercept is the backlash alone.
 */
float axisLash(bool isRoll, float *tauOut) {
  const uint8_t FAST = 40, SLOW = 120;
  float vF = LASH_STEP * 1000.0 / (float)FAST;
  float vS = LASH_STEP * 1000.0 / (float)SLOW;

  float aF = measureBacklash(isRoll, FAST);
  float aS = measureBacklash(isRoll, SLOW);
  if (aF < 0.0 || aS < 0.0) { *tauOut = -1.0; return -1.0; }

  float tau = (aF - aS) / (vF - vS);
  if (tau < 0.0) tau = 0.0;
  float lash = aF - vF * tau;
  if (lash < 0.0) lash = 0.0;

  *tauOut = tau;
  return lash;
}

void backlashReport() {
  Serial.println();
  Serial.println(F("backlash measurement, two rates per axis"));

  float tauR, tauP;
  float bR = axisLash(true,  &tauR);
  float bP = axisLash(false, &tauP);

  rampTo(baseRoll, basePitch);
  syncBase();
  lockCount = 0;

  Serial.println();
  if (bR >= 0.0) {
    Serial.print(F("roll  backlash ")); Serial.print(bR, 2);
    Serial.print(F(" deg   sensor tau ")); Serial.print(tauR * 1000.0, 0);
    Serial.println(F(" ms"));
  }
  if (bP >= 0.0) {
    Serial.print(F("pitch backlash ")); Serial.print(bP, 2);
    Serial.print(F(" deg   sensor tau ")); Serial.print(tauP * 1000.0, 0);
    Serial.println(F(" ms"));
  }

  float worst = (bR > bP) ? bR : bP;
  if (worst > 0.0) {
    float want = worst * 1.6;
    if (want < 2.0) want = 2.0;
    ditherLock = want;
    if (dither < want + 1.5) dither = want + 1.5;
    Serial.print(F("locked dither set to ")); Serial.print(want, 1);
    Serial.println(F(" deg (1.6x worst axis)"));
  }
}

/*
 * Pointing repeatability. Displaces the platform a fixed distance and
 * records where it re-converges. Approach direction alternates on each
 * axis so that hysteresis appears in the spread rather than hiding in
 * a consistent offset.
 */
void repeatability() {
  const uint8_t TRIALS = 4;
  const float   KICK   = 8.0;

  float rs[TRIALS], ps[TRIALS];

  Serial.println();
  Serial.println(F("repeatability: 4 approaches, keep the source fixed"));

  if (lastLight < lightFloor) {
    Serial.println(F("no lock; run 'f' first"));
    return;
  }

  for (uint8_t t = 0; t < TRIALS; t++) {
    float dr = (t & 1) ? KICK : -KICK;
    float dp = (t & 2) ? KICK : -KICK;

    Serial.print(F("  trial ")); Serial.print(t + 1);
    Serial.print(F(": offset ")); Serial.print(dr, 0);
    Serial.print(F(" / "));       Serial.print(dp, 0);

    rampTo(clampLimit(baseRoll + dr), clampLimit(basePitch + dp));
    syncBase();
    lockCount = 0;
    delay(200);

    for (uint8_t w = 0; w < 6 && lockCount < 2; w++) trackWindow();

    rs[t] = baseRoll;
    ps[t] = basePitch;
    Serial.print(F("   -> roll ")); Serial.print(rs[t], 2);
    Serial.print(F("  pitch "));    Serial.println(ps[t], 2);
  }

  float mr = 0, mp = 0;
  for (uint8_t t = 0; t < TRIALS; t++) { mr += rs[t]; mp += ps[t]; }
  mr /= TRIALS; mp /= TRIALS;

  float worst = 0;
  for (uint8_t t = 0; t < TRIALS; t++) {
    float er = fabs(rs[t] - mr);
    float ep = fabs(ps[t] - mp);
    if (er > worst) worst = er;
    if (ep > worst) worst = ep;
  }

  Serial.println();
  Serial.print(F("mean aim roll ")); Serial.print(mr, 2);
  Serial.print(F(" pitch "));        Serial.println(mp, 2);
  Serial.print(F("repeatability +/- ")); Serial.print(worst, 2);
  Serial.println(F(" deg"));
}

/*
 * Fixed-panel versus tracked-panel irradiance over an identical arc,
 * swept by hand. The tracked figure includes the dither excursions, so
 * it is charged for the energy the search costs.
 *
 * The fixed reference is the currently acquired aim point, not the
 * mechanical centre. A fixed installation is oriented toward the mean
 * sun position; benchmarking against an arbitrary angle measures how
 * badly the panel was installed, not what tracking is worth. Run 'f'
 * with the source at mid-arc before starting.
 *
 * Two caveats belong with any figure this produces. Arc reproduction is
 * manual, worth roughly +/-10%. More importantly the sensor is
 * collimated to a ~26 deg cone, while a PV module has a cosine response
 * out to +/-90 deg, so the fixed reference falls off far faster here
 * than a real panel would. The result overstates the gain against real
 * hardware and should be quoted as such.
 */
void benchmark() {
  delay(40);
  while (Serial.available()) Serial.read();

  const uint32_t DUR = 20000;

  if (lastLight < lightFloor) {
    Serial.println(F("no acquired aim point; run 'f' at mid-arc first"));
    return;
  }

  float fixR = baseRoll, fixP = basePitch;

  Serial.println();
  Serial.println(F("benchmark: fixed vs tracked, 20 s per phase"));
  Serial.print(F("fixed reference = acquired aim roll "));
  Serial.print(fixR, 1); Serial.print(F(" pitch ")); Serial.println(fixP, 1);
  Serial.println(F("sweep the source through the same arc in both"));
  Serial.println(F("phase 1 (fixed) in 3 s"));
  delay(3000);

  tracking = false;
  rampTo(fixR, fixP);
  syncBase();
  delay(400);

  uint32_t sum = 0; uint16_t n = 0;
  uint32_t t0 = millis();
  Serial.println(F("fixed"));
  if (benchCSV) {
    Serial.println(F("--- CSV BEGIN ---"));
    Serial.println(F("ms,mode,light"));
  }
  while (millis() - t0 < DUR) {
    int v = readLight();
    sum += (uint32_t)v;
    n++;
    if (benchCSV) {
      Serial.print(millis()); Serial.print(F(",fixed,")); Serial.println(v);
    }
    digitalWrite(PIN_LED, (millis() / 400) & 1);
    delay(150);
    if (Serial.available()) break;
  }
  uint32_t fixedAvg = n ? (sum / n) : 0;

  Serial.println();
  Serial.println(F("phase 2 (tracked), acquiring"));
  tracking = true;
  scanAcquire();
  if (!tracking) {
    Serial.println(F("aborted: no source"));
    return;
  }

  benchSum = 0; benchN = 0; benchActive = true;
  t0 = millis();
  Serial.println(F("tracked"));
  while (millis() - t0 < DUR) {
    trackWindow();
    if (Serial.available()) break;
  }
  benchActive = false;
  if (benchCSV) Serial.println(F("--- CSV END ---"));
  uint32_t trackAvg = benchN ? (benchSum / benchN) : 0;

  Serial.println();
  Serial.print(F("fixed   mean ")); Serial.print(fixedAvg);
  Serial.print(F("  n=")); Serial.println(n);
  Serial.print(F("tracked mean ")); Serial.print(trackAvg);
  Serial.print(F("  n=")); Serial.println(benchN);

  if (fixedAvg >= (uint32_t)(lightFloor / 3)) {
    long pct = ((long)trackAvg - (long)fixedAvg) * 100L / (long)fixedAvg;
    Serial.print(F("gain ")); Serial.print(pct); Serial.println(F(" %"));
    Serial.println(F("note: collimated sensor falls off faster than a"));
    Serial.println(F("cosine-response panel; this overstates real gain"));
  } else {
    // A near-dark fixed phase means the reference was never pointed at
    // the source, so the ratio measures aiming, not tracking.
    Serial.println(F("fixed mean too low to compare - the reference was"));
    Serial.println(F("dark for the whole phase. re-run 'f' with the"));
    Serial.println(F("source at the MIDDLE of the arc, then sweep"));
    Serial.println(F("symmetrically either side of it."));
  }

  delay(40);
  while (Serial.available()) Serial.read();
}

void printHelp() {
  Serial.println(F("--------------------------------------------------"));
  Serial.println(F(" s  start/stop tracking     c  centre (90,90)"));
  Serial.println(F(" f  acquire                 m  light meter"));
  Serial.println(F(" b  benchmark fixed vs tracked"));
  Serial.println(F(" k  measure backlash        p  repeatability"));
  Serial.println(F(" l  toggle CSV logging in benchmark"));
  Serial.println(F(" +/-  dither amplitude      [/]  gain"));
  Serial.println(F(" </>  light floor           r  reset peak"));
  Serial.println(F("--------------------------------------------------"));
}

/*
 * Continuous readout, used to verify sensor polarity and collimation.
 * Brightness must fall when the sensor is covered; if it rises, flip
 * INVERT_READING.
 *
 * The leading flush discards the line ending the Serial Monitor appends
 * to the command, which would otherwise satisfy the exit condition
 * immediately.
 */
void lightMeter() {
  delay(40);
  while (Serial.available()) Serial.read();

  Serial.println(F("light meter; any key exits"));
  Serial.println(F("raw   bright"));

  int lo = 1023, hi = 0;
  while (!Serial.available()) {
    int raw = analogRead(PIN_LDR);
    int v   = readLight();
    if (v < lo) lo = v;
    if (v > hi) hi = v;

    Serial.print(raw);   Serial.print(F("\t"));
    Serial.print(v);     Serial.print(F("\t"));
    for (int i = 0; i < v / 24; i++) Serial.print('#');
    Serial.println();
    delay(120);
  }
  while (Serial.available()) Serial.read();

  Serial.print(F("swing ")); Serial.print(hi - lo);
  Serial.println(F(" counts"));
}

void handleSerial() {
  while (Serial.available()) {
    char ch = (char)Serial.read();
    switch (ch) {
      case 's': case 'S':
        tracking = !tracking;
        lockCount = 0;
        if (tracking) syncBase();
        Serial.println(tracking ? F("tracking on") : F("tracking off"));
        break;

      case 'c': case 'C':
        tracking = false;
        rampTo(CENTER, CENTER);
        syncBase();
        Serial.println(F("centred"));
        break;

      case 'm': case 'M': lightMeter();      break;
      case 'b': case 'B': benchmark();       break;
      case 'k': case 'K': backlashReport();  break;
      case 'p': case 'P': repeatability();   break;

      case 'f': case 'F':
        tracking = true;
        scanAcquire();
        break;

      case 'l': case 'L':
        benchCSV = !benchCSV;
        Serial.print(F("csv "));
        Serial.println(benchCSV ? F("on") : F("off"));
        break;

      // Both amplitudes move together so the locked dither cannot be
      // tuned below the backlash.
      case '+': case '=':
        dither     += 0.5;
        ditherLock += 0.5;
        Serial.print(F("dither ")); Serial.print(dither, 1);
        Serial.print(F(" / ")); Serial.println(ditherLock, 1);
        break;

      case '-': case '_':
        dither     -= 0.5;
        ditherLock -= 0.5;
        if (dither < 1.5) dither = 1.5;
        if (ditherLock < 1.0) ditherLock = 1.0;
        Serial.print(F("dither ")); Serial.print(dither, 1);
        Serial.print(F(" / ")); Serial.println(ditherLock, 1);
        break;

      case ']':
        gainRel += 1.0;
        Serial.print(F("gain ")); Serial.println(gainRel, 1);
        break;

      case '[':
        gainRel -= 1.0;
        if (gainRel < 1.0) gainRel = 1.0;
        Serial.print(F("gain ")); Serial.println(gainRel, 1);
        break;

      case '>': case '.':
        lightFloor += 25;
        Serial.print(F("light floor ")); Serial.println(lightFloor);
        break;

      case '<': case ',':
        lightFloor -= 25;
        if (lightFloor < 0) lightFloor = 0;
        Serial.print(F("light floor ")); Serial.println(lightFloor);
        break;

      case 'r': case 'R':
        bestLight = 0;
        Serial.println(F("peak reset"));
        break;

      case '?': case 'h': case 'H': printHelp(); break;
      default: break;
    }
  }
}

void setup() {
  Serial.begin(115200);
  delay(300);

#if USE_INTERNAL_PULLUP
  pinMode(PIN_LDR, INPUT_PULLUP);
#else
  pinMode(PIN_LDR, INPUT);
#endif

  pinMode(PIN_LED, OUTPUT);
  digitalWrite(PIN_LED, LOW);

  servoRoll.attach(PIN_ROLL);
  servoPitch.attach(PIN_PITCH);
  cmdRoll  = CENTER;
  cmdPitch = CENTER;
  writeServos();
  syncBase();
  delay(400);

  Serial.println();
  Serial.println(F("single-sensor dual-axis solar tracker"));
  printHelp();
  Serial.print(F("ambient ")); Serial.println(readLight());
  Serial.println(F("idle; 'm' to verify the sensor, 'f' to acquire"));
}

void loop() {
  handleSerial();

  if (!tracking) {
    delay(20);
    return;
  }

  trackWindow();

  // Two consecutive dark windows before re-acquiring, so a transient
  // occlusion does not discard a valid lock.
  if (lost) darkCount++;
  else      darkCount = 0;

  if (darkCount >= 2) {
    darkCount = 0;
    scanAcquire();
  }
}
